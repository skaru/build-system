## Kconfig
```kconfig
mainmenu "Config"
	menu "Components"
		menu "Foo"
			config FOO_ENABLE
				bool "enable"
		endmenu

		menu "Bar"
			config BAR_VALUE
				int "Value"
				default 40
		endmenu
endmenu
```
